## NBOSP/os/Config.in
```kconfig
menu "NBOSP"

source "$BR2_EXTERNAL_NBOSP_PATH/package/nbosp-kiosk/Config.in"
source "$BR2_EXTERNAL_NBOSP_PATH/package/nbosp-power/Config.in"
source "$BR2_EXTERNAL_NBOSP_PATH/package/nbosp-install/Config.in"
source "$BR2_EXTERNAL_NBOSP_PATH/package/noto-emoji/Config.in"

endmenu
```

## NBOSP/os/configs/nbosp_x86_64_defconfig
```kconfig
BR2_x86_64=y
BR2_TOOLCHAIN_BUILDROOT=y
BR2_TOOLCHAIN_BUILDROOT_GLIBC=y
BR2_TOOLCHAIN_BUILDROOT_CXX=y
BR2_ENABLE_LOCALE=y
BR2_SHARED_LIBS=y
BR2_KERNEL_HEADERS_AS_KERNEL=y
BR2_PACKAGE_HOST_LINUX_HEADERS_CUSTOM_6_12=y
BR2_TARGET_GENERIC_HOSTNAME="nbosp"
BR2_TARGET_GENERIC_ISSUE="NBOSP live boot"
BR2_TARGET_GENERIC_GETTY=y
BR2_TARGET_GENERIC_GETTY_PORT="tty2"
BR2_ROOTFS_DEVICE_CREATION_DYNAMIC_EUDEV=y
BR2_PACKAGE_EUDEV=y
BR2_ROOTFS_USERS_TABLES="$(BR2_EXTERNAL_NBOSP_PATH)/board/nbosp/users.table"
BR2_ROOTFS_DEVICE_TABLE="$(BR2_EXTERNAL_NBOSP_PATH)/board/nbosp/device_table.txt"
BR2_ROOTFS_OVERLAY="$(BR2_EXTERNAL_NBOSP_PATH)/board/nbosp/rootfs-overlay"
BR2_ROOTFS_POST_BUILD_SCRIPT="$(BR2_EXTERNAL_NBOSP_PATH)/board/nbosp/post-build.sh"
BR2_SYSTEM_BIN_SH_BUSYBOX=y
BR2_PACKAGE_BUSYBOX_CONFIG_FRAGMENT_FILES="$(BR2_EXTERNAL_NBOSP_PATH)/board/nbosp/busybox.fragment"
BR2_PACKAGE_LIBGTK3=y
BR2_PACKAGE_LIBGTK3_WAYLAND=y
BR2_PACKAGE_LIBGTK3_X11=y
BR2_PACKAGE_LIBNSS=y
BR2_PACKAGE_LIBNSPR=y
BR2_PACKAGE_CA_CERTIFICATES=y
BR2_PACKAGE_OPENSSL=y
BR2_PACKAGE_LIBCURL=y
BR2_PACKAGE_LIBCURL_CURL=y
BR2_PACKAGE_LIBCURL_OPENSSL=y
BR2_PACKAGE_FONTCONFIG=y
BR2_PACKAGE_NOTO_EMOJI=y
BR2_PACKAGE_DEJAVU=y
BR2_PACKAGE_DEJAVU_SANS=y
BR2_PACKAGE_DEJAVU_MONO=y
BR2_PACKAGE_ALSA_LIB=y
BR2_PACKAGE_ALSA_UTILS=y
BR2_PACKAGE_ALSA_UTILS_ALSACTL=y
BR2_PACKAGE_ALSA_UTILS_AMIXER=y
BR2_PACKAGE_ALSA_UTILS_APLAY=y
BR2_PACKAGE_CUPS=y
BR2_PACKAGE_XORG7=y
BR2_PACKAGE_XORGPROTO=y
BR2_PACKAGE_LIBGLVND=y
BR2_PACKAGE_LIBEPOXY=y
BR2_PACKAGE_LIBDRM_VMWGFX=y
BR2_PACKAGE_XLIB_LIBX11=y
BR2_PACKAGE_XLIB_LIBXCOMPOSITE=y
BR2_PACKAGE_XLIB_LIBXCURSOR=y
BR2_PACKAGE_XLIB_LIBXDAMAGE=y
BR2_PACKAGE_XLIB_LIBXEXT=y
BR2_PACKAGE_XLIB_LIBXFIXES=y
BR2_PACKAGE_XLIB_LIBXI=y
BR2_PACKAGE_XLIB_LIBXRANDR=y
BR2_PACKAGE_XLIB_LIBXRENDER=y
BR2_PACKAGE_XLIB_LIBXSCRNSAVER=y
BR2_PACKAGE_XLIB_LIBXTST=y
BR2_PACKAGE_MESA3D=y
BR2_PACKAGE_MESA3D_GALLIUM_DRIVER_SVGA=y
BR2_PACKAGE_MESA3D_OPENGL_EGL=y
BR2_PACKAGE_MESA3D_OPENGL_ES=y
BR2_PACKAGE_MESA3D_OPENGL_GLX=y
BR2_PACKAGE_MESA3D_GBM=y
BR2_PACKAGE_CAGE=y
BR2_PACKAGE_WLROOTS_XWAYLAND=y
BR2_PACKAGE_XWAYLAND=y
BR2_PACKAGE_MESA3D_DEMOS=y
BR2_PACKAGE_WAYLAND_UTILS=y
BR2_PACKAGE_STRACE=y
BR2_PACKAGE_SEATD=y
BR2_PACKAGE_SEATD_DAEMON=y
BR2_PACKAGE_DBUS=y
BR2_PACKAGE_NETWORK_MANAGER=y
BR2_PACKAGE_NETWORK_MANAGER_CLI=y
BR2_PACKAGE_POLKIT=y
BR2_PACKAGE_WPA_SUPPLICANT=y
BR2_PACKAGE_WPA_SUPPLICANT_NL80211=y
BR2_PACKAGE_BLUEZ5_UTILS=y
BR2_PACKAGE_BLUEZ5_UTILS_CLIENT=y
BR2_PACKAGE_BLUEZ5_UTILS_PLUGINS_AUDIO=y
BR2_PACKAGE_BLUEZ5_UTILS_PLUGINS_HID=y
BR2_PACKAGE_BLUEZ5_UTILS_PLUGINS_HOG=y
BR2_PACKAGE_LINUX_FIRMWARE=y
BR2_PACKAGE_LINUX_FIRMWARE_IWLWIFI_6E=y
BR2_PACKAGE_LINUX_FIRMWARE_IWLWIFI_9XXX=y
BR2_PACKAGE_LINUX_FIRMWARE_IWLWIFI_22000=y
BR2_PACKAGE_XKEYBOARD_CONFIG=y
BR2_PACKAGE_XDATA_XCURSOR_THEMES=y
BR2_PACKAGE_LIBARCHIVE=y
BR2_PACKAGE_LIBARCHIVE_BSDTAR=y
BR2_PACKAGE_UTIL_LINUX_LIBUUID=y
BR2_PACKAGE_SUDO=y
BR2_PACKAGE_OPENVMTOOLS=y
BR2_PACKAGE_OPENVMTOOLS_RESOLUTIONKMS=y
BR2_PACKAGE_OPENVMTOOLS_DESKTOP=y
BR2_PACKAGE_LIBFUSE3=y
BR2_PACKAGE_NBOSP_KIOSK=y
BR2_PACKAGE_NBOSP_POWER=y
BR2_PACKAGE_NBOSP_INSTALL=y
BR2_LINUX_KERNEL=y
BR2_LINUX_KERNEL_CUSTOM_VERSION=y
BR2_LINUX_KERNEL_CUSTOM_VERSION_VALUE="6.12.18"
BR2_LINUX_KERNEL_USE_DEFCONFIG=y
BR2_LINUX_KERNEL_DEFCONFIG="x86_64"
BR2_LINUX_KERNEL_CONFIG_FRAGMENT_FILES="$(BR2_EXTERNAL_NBOSP_PATH)/board/nbosp/linux.fragment"
BR2_TARGET_ROOTFS_CPIO=y
BR2_TARGET_ROOTFS_CPIO_GZIP=y
BR2_TARGET_ROOTFS_TAR=y
BR2_GLOBAL_PATCH_DIR="$(BR2_EXTERNAL_NBOSP_PATH)/patches"
```

## NBOSP/os/package/nbosp-install/Config.in
```kconfig
config BR2_PACKAGE_NBOSP_INSTALL
	bool "NBOSP disk installer helper"
	depends on BR2_x86_64
	select BR2_PACKAGE_DOSFSTOOLS
	select BR2_PACKAGE_DOSFSTOOLS_MKFS_FAT
	select BR2_PACKAGE_E2FSPROGS
	select BR2_TARGET_GRUB2
	select BR2_TARGET_GRUB2_I386_PC
	select BR2_TARGET_GRUB2_X86_64_EFI
	select BR2_TARGET_GRUB2_INSTALL_TOOLS
	select BR2_PACKAGE_UTIL_LINUX
	select BR2_PACKAGE_UTIL_LINUX_BINARIES
	help
	  Install a narrow setuid helper and root-owned script for installing
	  NBOSP to a selected disk. The installer repartitions and erases it.
```

## NBOSP/os/package/nbosp-kiosk/Config.in
```kconfig
config BR2_PACKAGE_NBOSP_KIOSK
	bool "NBOSP NW.js kiosk app"
	depends on BR2_x86_64
	help
	  Install the Linux NW.js application bundle into the target filesystem.
```

## NBOSP/os/package/nbosp-power/Config.in
```kconfig
config BR2_PACKAGE_NBOSP_POWER
	bool "NBOSP restricted power helper"
	depends on BR2_x86_64
	help
	  Install a small setuid helper that permits only reboot and power-off.
```

## astro-os/os/Config.in
```kconfig
menu "AstroOS"

source "$BR2_EXTERNAL_ASTROOS_PATH/package/astroos-kiosk/Config.in"
source "$BR2_EXTERNAL_ASTROOS_PATH/package/astroos-power/Config.in"
source "$BR2_EXTERNAL_ASTROOS_PATH/package/astroos-install/Config.in"
source "$BR2_EXTERNAL_ASTROOS_PATH/package/noto-emoji/Config.in"

endmenu
```

## astro-os/os/package/astroos-power/Config.in
```kconfig
config BR2_PACKAGE_ASTROOS_POWER
	bool "AstroOS restricted power helper"
	depends on BR2_x86_64
	help
	  Install a small setuid helper that permits only reboot and power-off.
```

## astro-os/os/package/labwc/Config.in
```kconfig
config BR2_PACKAGE_LABWC
        bool "labwc"
        depends on BR2_USE_MMU # fork()
        select BR2_PACKAGE_CAIRO
        select BR2_PACKAGE_LIBGLIB2
        select BR2_PACKAGE_LIBINPUT
        select BR2_PACKAGE_LIBPNG
        select BR2_PACKAGE_LIBXCB
        select BR2_PACKAGE_LIBXKBCOMMON
        select BR2_PACKAGE_LIBXML2
        select BR2_PACKAGE_PANGO
        select BR2_PACKAGE_PIXMAN
        select BR2_PACKAGE_WAYLAND
        select BR2_PACKAGE_WAYLAND_PROTOCOLS
        select BR2_PACKAGE_WLROOTS
        select BR2_PACKAGE_WLROOTS_XWAYLAND
        select BR2_PACKAGE_XWAYLAND
        select BR2_PACKAGE_XCB_UTIL_WM
        help
          Labwc is a wlroots-based window-stacking compositor for Wayland,
          inspired by Openbox. AstroOS uses it as the kiosk compositor because,
          unlike cage, it supports stacking surfaces and the layer-shell
          protocol, letting the OS display system UI on top of the fullscreen
          app window.

          https://github.com/labwc/labwc
```

## astro-os/os/package/noto-emoji/Config.in
```kconfig
config BR2_PACKAGE_NOTO_EMOJI
	bool "Noto Color Emoji font"
	depends on BR2_PACKAGE_FONTCONFIG
	help
	  Install Google's Noto Color Emoji font for emoji rendering in NW.js and
	  other applications using Fontconfig.
```
